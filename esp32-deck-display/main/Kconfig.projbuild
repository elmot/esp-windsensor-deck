## esp32-deck-display/main/Kconfig.projbuild
```kconfig
menu "Windsensor Configuration"

    config ESP_WIFI_SSID
        string "WiFi SSID"
        default "yanus-wind"
        help
            SSID (network name) to set up the softAP with.

    config ESP_WIFI_PASSWORD
        string "SoftAP Password"
        default "EglaisEglais"
        help
            WiFi password (WPA or WPA2) for softAP

    config NMEA_UDP_PORT
        int "NMEA UDP broadcast port"
        default 9000

    config WIFI_STA_TIMEOUT
        int "Wi-Fi connection timeout, seconds"
        default 5

    config ALARM_LED_PIN
        int "Alarm LED GPIO pin"
        default 5

    config ALARM_LED_PIN_INVERTED
        int "Alarm LED GPIO pin"
        default 4

    config BACKLIGHT_UP_PIN
        int "LCB backlight intensity increase button pin"
        default 18

    config BACKLIGHT_DOWN_PIN
        int "LCB backlight intensity decrease button pin"
        default 19

endmenu
```
